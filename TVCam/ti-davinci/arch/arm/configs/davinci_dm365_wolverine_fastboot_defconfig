## TVCam/ti-davinci/arch/arm/mach-realview/Kconfig
```kconfig
menu "RealView platform type"
	depends on ARCH_REALVIEW

config MACH_REALVIEW_EB
	bool "Support RealView/EB platform"
	select ARM_GIC
	help
	  Include support for the ARM(R) RealView Emulation Baseboard platform.

config MACH_REALVIEW_PB1176
 	bool "Support RealView/PB1176 platform"
 	select ARM_GIC
 	help
 	  Include support for the ARM(R) RealView ARM1176 Platform Baseboard.

config REALVIEW_PISMO_ETHERNET
	bool "Enable PISMO SMSC9118 Ethernet"
	depends on MACH_REALVIEW_PB1176
	help
	 Select support for SMSC9118 Ethernet PISMO card. Note that enabling
	 this option replaces support for the on-board ethernet controller.

config REALVIEW_MPCORE
	bool "Support MPcore tile"
	depends on MACH_REALVIEW_EB
	select CACHE_L2X0
	help
	  Enable support for the MPCore tile on the Realview platform.
	  Since there are device address and interrupt differences, a
	  kernel built with this option enabled is not compatible with
	  other tiles.

config REALVIEW_MPCORE_REVB
	bool "Support MPcore RevB tile"
	depends on REALVIEW_MPCORE
	depends on MACH_REALVIEW_EB
	default n
	help
	  Enable support for the MPCore RevB tile on the Realview platform.
	  Since there are device address differences, a
	  kernel built with this option enabled is not compatible with
	  other tiles.

endmenu
```

## TVCam/ti-davinci/arch/arm/plat-davinci/Kconfig
```kconfig
if ARCH_DAVINCI

comment "TI DaVinci Implementations"

choice
	prompt "DaVinci Core Type"
	default ARCH_DAVINCI_TRUE

config ARCH_DAVINCI_TRUE
	bool "True DaVinci Core"

config ARCH_DA8XX
	bool "DA830/OMAP-L137 DaVinci-like Core"
	select TI_CP_INTC

endchoice

config DAVINCI_MUX
	bool "DAVINCI multiplexing support"
	default y
	help
	  Pin multiplexing support for DAVINCI boards. If your bootloader
	  sets the multiplexing correctly, say N. Otherwise, or if unsure,
	  say Y.

config DAVINCI_MUX_DEBUG
	bool "Multiplexing debug output"
	depends on DAVINCI_MUX
	help
	  Makes the multiplexing functions print out a lot of debug info.
	  This is useful if you want to find out the correct values of the
	  multiplexing registers.

config DAVINCI_MUX_WARNINGS
	bool "Warn about pins the bootloader didn't set up"
	depends on DAVINCI_MUX
	default y
	help
	  Choose Y here to warn whenever driver initialization logic needs
	  to change the pin multiplexing setup.  When there are no warnings
	  printed, it's safe to deselect DAVINCI_MUX for your product.

config DAVINCI_I2C_EXPANDER
	bool "TI DaVinci I2C Expander support"
	default y
	depends on I2C
	help
	  Configure this option to specify whether the board used has I2C
	  expander which controls ATA, CF, USB.

config SKIP_EDMA3_REGS_INIT
	bool "Skip EDMA3 global registers initalization"
	default n
	help
	  Select this option if EDMA3 global registers
	  (Event Queue Priority, Event Queue Watermark Level,
	  Error and PaRAM) are initialized by DSP code and
	  ARM should not overwrite it.

endif
```

## TVCam/ti-davinci/arch/powerpc/platforms/82xx/Kconfig
```kconfig
choice
       prompt "82xx Board Type"
       depends on PPC_82xx
       default MPC8272ADS

config MPC8272ADS
       bool "Freescale MPC8272ADS"
       select DEFAULT_UIMAGE
       select PQ2ADS
       select 8272
       select 8260
       select FSL_SOC
       select PQ2_ADS_PCI_PIC if PCI
       help
         This option enables support for the MPC8272 ADS board

endchoice

config PQ2_ADS_PCI_PIC
	bool
```

## TVCam/ti-davinci/arch/powerpc/platforms/83xx/Kconfig
```kconfig
choice
	prompt "83xx Board Type"
	depends on PPC_83xx
	default MPC834x_SYS

config MPC8313_RDB
	bool "Freescale MPC8313 RDB"
	select DEFAULT_UIMAGE
	help
	  This option enables support for the MPC8313 RDB board.

config MPC831x_RDB
	bool "Freescale MPC831x RDB"
	select DEFAULT_UIMAGE
	help
	  This option enables support for the MPC8313 RDB and MPC8315 RDB boards.

config MPC832x_MDS
	bool "Freescale MPC832x MDS"
	select DEFAULT_UIMAGE
	select QUICC_ENGINE
	help
	  This option enables support for the MPC832x MDS evaluation board.

config MPC832x_RDB
	bool "Freescale MPC832x RDB"
	select DEFAULT_UIMAGE
	select QUICC_ENGINE
	help
	  This option enables support for the MPC8323 RDB board.

config MPC834x_SYS
	bool "Freescale MPC834x SYS"
	select DEFAULT_UIMAGE
	help
	  This option enables support for the MPC 834x SYS evaluation board.

	  Be aware that PCI buses can only function when SYS board is plugged
	  into the PIB (Platform IO Board) board from Freescale which provide
	  3 PCI slots.  The PIBs PCI initialization is the bootloader's
	  responsiblilty.

config MPC834x_ITX
	bool "Freescale MPC834x ITX"
	select DEFAULT_UIMAGE
	help
	  This option enables support for the MPC 834x ITX evaluation board.

	  Be aware that PCI initialization is the bootloader's
	  responsiblilty.

config MPC8360E_PB
	bool "Freescale MPC8360E PB"
	select DEFAULT_UIMAGE
	select QUICC_ENGINE
	help
	  This option enables support for the MPC836x EMDS Processor Board.

config MPC836x_RDK
	bool "Freescale/Logic MPC836x RDK"
	select DEFAULT_UIMAGE
	select QUICC_ENGINE
	select FSL_UPM
	help
	  This option enables support for the MPC836x RDK Processor Board,
	  also known as ZOOM PowerQUICC Kit.

config MPC837x_RDB
	bool "Freescale MPC837x RDB"
	select DEFAULT_UIMAGE
	select PPC_MPC837x
	help
	  This option enables support for the MPC837x RDB Board.

endchoice

config PPC_MPC831x
	bool
	select PPC_UDBG_16550
	select PPC_INDIRECT_PCI
	select FSL_PCI if PCI
	default y if MPC8313_RDB || MPC831x_RDB

config PPC_MPC832x
	bool
	select PPC_UDBG_16550
	select PPC_INDIRECT_PCI
	default y if MPC832x_MDS || MPC832x_RDB

config MPC834x
	bool
	select PPC_UDBG_16550
	select PPC_INDIRECT_PCI
	default y if MPC834x_SYS || MPC834x_ITX

config PPC_MPC836x
	bool
	select PPC_UDBG_16550
	select PPC_INDIRECT_PCI
	default y if MPC8360E_PB || MPC836x_RDK

config PPC_MPC837x
	bool
	select PPC_UDBG_16550
	select PPC_INDIRECT_PCI
	select FSL_PCI if PCI
```

## TVCam/ti-davinci/arch/powerpc/platforms/Kconfig
```kconfig
menu "Platform support"

choice
	prompt "Machine type"
	depends on PPC64 || 6xx
	default PPC_MULTIPLATFORM

config PPC_MULTIPLATFORM
	bool "Generic desktop/server/laptop"
	help
	  Select this option if configuring for an IBM pSeries or
	  RS/6000 machine, an Apple machine, or a PReP, CHRP,
	  Maple or Cell-based machine.

config PPC_82xx
	bool "Freescale 82xx"
	depends on 6xx

config PPC_83xx
	bool "Freescale 83xx"
	depends on 6xx
	select FSL_SOC
	select 83xx
	select WANT_DEVICE_TREE

config PPC_86xx
	bool "Freescale 86xx"
	depends on 6xx
	select FSL_SOC
	select ALTIVEC
	help
	  The Freescale E600 SoCs have 74xx cores.
endchoice

config CLASSIC32
	def_bool y
	depends on 6xx && PPC_MULTIPLATFORM

config QUICC_ENGINE
	bool
	select PPC_LIB_RHEAP
	select GENERIC_GPIO
	select HAVE_GPIO_LIB
	help
	  The QUICC Engine (QE) is a new generation of communications
	  coprocessors on Freescale embedded CPUs (akin to CPM in older chips).
	  Selecting this option means that you wish to build a kernel
	  for a machine with a QE coprocessor.

config PPC_PSERIES
	depends on PPC_MULTIPLATFORM && PPC64
	bool "IBM pSeries & new (POWER5-based) iSeries"
	select MPIC
	select PPC_I8259
	select PPC_RTAS
	select RTAS_ERROR_LOGGING
	select PPC_UDBG_16550
	select PPC_NATIVE
	default y

config PPC_ISERIES
	bool "IBM Legacy iSeries"
	depends on PPC_MULTIPLATFORM && PPC64
	select PPC_INDIRECT_IO

config PPC_CHRP
	bool "Common Hardware Reference Platform (CHRP) based machines"
	depends on PPC_MULTIPLATFORM && PPC32
	select MPIC
	select PPC_I8259
	select PPC_INDIRECT_PCI
	select PPC_RTAS
	select PPC_MPC106
	select PPC_UDBG_16550
	select PPC_NATIVE
	default y

config PPC_MPC52xx
	bool
	default n

config PPC_EFIKA
	bool "bPlan Efika 5k2. MPC5200B based computer"
	depends on PPC_MULTIPLATFORM && PPC32
	select PPC_RTAS
	select RTAS_PROC
	select PPC_MPC52xx
	select PPC_NATIVE
	default y

config PPC_LITE5200
	bool "Freescale Lite5200 Eval Board"
	depends on PPC_MULTIPLATFORM && PPC32
	select PPC_MPC52xx
	default n

config PPC_PMAC
	bool "Apple PowerMac based machines"
	depends on PPC_MULTIPLATFORM
	select MPIC
	select PPC_INDIRECT_PCI if PPC32
	select PPC_MPC106 if PPC32
	select PPC_NATIVE
	default y

config PPC_PMAC64
	bool
	depends on PPC_PMAC && POWER4
	select MPIC
	select U3_DART
	select MPIC_U3_HT_IRQS
	select GENERIC_TBSYNC
	select PPC_970_NAP
	default y

config PPC_PREP
	bool "PowerPC Reference Platform (PReP) based machines"
	depends on PPC_MULTIPLATFORM && PPC32 && BROKEN
	select MPIC
	select PPC_I8259
	select PPC_INDIRECT_PCI
	select PPC_UDBG_16550
	select PPC_NATIVE
	default y

config PPC_MAPLE
	depends on PPC_MULTIPLATFORM && PPC64
	bool "Maple 970FX Evaluation Board"
	select MPIC
	select U3_DART
	select MPIC_U3_HT_IRQS
	select GENERIC_TBSYNC
	select PPC_UDBG_16550
	select PPC_970_NAP
	select PPC_NATIVE
	select PPC_RTAS
	default n
	help
          This option enables support for the Maple 970FX Evaluation Board.
	  For more informations, refer to <http://www.970eval.com>

config PPC_PASEMI
	depends on PPC_MULTIPLATFORM && PPC64
	bool "PA Semi SoC-based platforms"
	default n
	select MPIC
	select PPC_UDBG_16550
	select GENERIC_TBSYNC
	select PPC_NATIVE
	help
	  This option enables support for PA Semi's PWRficient line
	  of SoC processors, including PA6T-1682M

config PPC_CELL
	bool
	default n

config PPC_CELL_NATIVE
	bool
	select PPC_CELL
	select PPC_DCR_MMIO
	select PPC_OF_PLATFORM_PCI
	select PPC_NATIVE
	select MPIC
	default n

config PPC_IBM_CELL_BLADE
	bool "IBM Cell Blade"
	depends on PPC_MULTIPLATFORM && PPC64
	select PPC_CELL_NATIVE
	select PPC_RTAS
	select MMIO_NVRAM
	select PPC_UDBG_16550
	select UDBG_RTAS_CONSOLE

config PPC_PS3
	bool "Sony PS3"
	depends on PPC_MULTIPLATFORM && PPC64
	select PPC_CELL
	help
	  This option enables support for the Sony PS3 game console
	  and other platforms using the PS3 hypervisor.

config PPC_CELLEB
	bool "Toshiba's Cell Reference Set 'Celleb' Architecture"
	depends on PPC_MULTIPLATFORM && PPC64
	select PPC_CELL
	select PPC_OF_PLATFORM_PCI
	select HAS_TXX9_SERIAL
	select PPC_UDBG_BEAT
	select USB_OHCI_BIG_ENDIAN_MMIO
	select USB_EHCI_BIG_ENDIAN_MMIO

source "arch/powerpc/platforms/ps3/Kconfig"
source "arch/powerpc/platforms/cell/Kconfig"
source "arch/powerpc/platforms/8xx/Kconfig"
source "arch/powerpc/platforms/82xx/Kconfig"
source "arch/powerpc/platforms/83xx/Kconfig"
source "arch/powerpc/platforms/85xx/Kconfig"
source "arch/powerpc/platforms/86xx/Kconfig"
source "arch/powerpc/platforms/embedded6xx/Kconfig"
source "arch/powerpc/platforms/44x/Kconfig"
source "arch/powerpc/platforms/40x/Kconfig"

config PPC_NATIVE
	bool
	depends on PPC_MULTIPLATFORM
	help
	  Support for running natively on the hardware, i.e. without
	  a hypervisor. This option is not user-selectable but should
	  be selected by all platforms that need it.

config UDBG_RTAS_CONSOLE
	bool "RTAS based debug console"
	depends on PPC_RTAS
	default n

config PPC_UDBG_BEAT
	bool "BEAT based debug console"
	depends on PPC_CELLEB
	default n

config XICS
	depends on PPC_PSERIES
	bool
	default y

config MPIC
	bool
	default n

config MPIC_WEIRD
	bool
	default n

config PPC_I8259
	bool
	default n

config U3_DART
	bool 
	depends on PPC_MULTIPLATFORM && PPC64
	default n

config PPC_RTAS
	bool
	default n

config RTAS_ERROR_LOGGING
	bool
	depends on PPC_RTAS
	default n

config RTAS_PROC
	bool "Proc interface to RTAS"
	depends on PPC_RTAS
	default y

config RTAS_FLASH
	tristate "Firmware flash interface"
	depends on PPC64 && RTAS_PROC

config MMIO_NVRAM
	bool
	default n

config MPIC_U3_HT_IRQS
	bool
	depends on PPC_MAPLE
	default y

config IBMVIO
	depends on PPC_PSERIES || PPC_ISERIES
	bool
	default y

config IBMEBUS
	depends on PPC_PSERIES
	bool "Support for GX bus based adapters"
	help
	  Bus device driver for GX bus based adapters.

config PPC_MPC106
	bool
	default n

config PPC_970_NAP
	bool
	default n

config PPC_INDIRECT_IO
	bool
	select GENERIC_IOMAP
	default n

config GENERIC_IOMAP
	bool
	default n

source "drivers/cpufreq/Kconfig"

config CPU_FREQ_PMAC
	bool "Support for Apple PowerBooks"
	depends on CPU_FREQ && ADB_PMU && PPC32
	select CPU_FREQ_TABLE
	help
	  This adds support for frequency switching on Apple PowerBooks,
	  this currently includes some models of iBook & Titanium
	  PowerBook.

config CPU_FREQ_PMAC64
	bool "Support for some Apple G5s"
	depends on CPU_FREQ && PPC64
	select CPU_FREQ_TABLE
	help
	  This adds support for frequency switching on Apple iMac G5,
	  and some of the more recent desktop G5 machines as well.

config PPC601_SYNC_FIX
	bool "Workarounds for PPC601 bugs"
	depends on 6xx && (PPC_PREP || PPC_PMAC)
	help
	  Some versions of the PPC601 (the first PowerPC chip) have bugs which
	  mean that extra synchronization instructions are required near
	  certain instructions, typically those that make major changes to the
	  CPU state.  These extra instructions reduce performance slightly.
	  If you say N here, these extra instructions will not be included,
	  resulting in a kernel which will run faster but may not run at all
	  on some systems with the PPC601 chip.

	  If in doubt, say Y here.

config TAU
	bool "On-chip CPU temperature sensor support"
	depends on 6xx
	help
	  G3 and G4 processors have an on-chip temperature sensor called the
	  'Thermal Assist Unit (TAU)', which, in theory, can measure the on-die
	  temperature within 2-4 degrees Celsius. This option shows the current
	  on-die temperature in /proc/cpuinfo if the cpu supports it.

	  Unfortunately, on some chip revisions, this sensor is very inaccurate
	  and in many cases, does not work at all, so don't assume the cpu
	  temp is actually what /proc/cpuinfo says it is.

config TAU_INT
	bool "Interrupt driven TAU driver (DANGEROUS)"
	depends on TAU
	---help---
	  The TAU supports an interrupt driven mode which causes an interrupt
	  whenever the temperature goes out of range. This is the fastest way
	  to get notified the temp has exceeded a range. With this option off,
	  a timer is used to re-check the temperature periodically.

	  However, on some cpus it appears that the TAU interrupt hardware
	  is buggy and can cause a situation which would lead unexplained hard
	  lockups.

	  Unless you are extending the TAU driver, or enjoy kernel/hardware
	  debugging, leave this option off.

config TAU_AVERAGE
	bool "Average high and low temp"
	depends on TAU
	---help---
	  The TAU hardware can compare the temperature to an upper and lower
	  bound.  The default behavior is to show both the upper and lower
	  bound in /proc/cpuinfo. If the range is large, the temperature is
	  either changing a lot, or the TAU hardware is broken (likely on some
	  G4's). If the range is small (around 4 degrees), the temperature is
	  relatively stable.  If you say Y here, a single temperature value,
	  halfway between the upper and lower bounds, will be reported in
	  /proc/cpuinfo.

	  If in doubt, say N here.

config CPM2
	bool
	default n
	select CPM
	select PPC_LIB_RHEAP
	help
	  The CPM2 (Communications Processor Module) is a coprocessor on
	  embedded CPUs made by Freescale.  Selecting this option means that
	  you wish to build a kernel for a machine with a CPM2 coprocessor
	  on it (826x, 827x, 8560).

config FSL_ULI1575
	bool
	default n
	select GENERIC_ISA_DMA
	help
	  Supports for the ULI1575 PCIe south bridge that exists on some
	  Freescale reference boards. The boards all use the ULI in pretty
	  much the same way.

config OF_RTC
	bool
	help
	  Uses information from the OF or flattened device tree to instatiate
	  platform devices for direct mapped RTC chips like the DS1742 or DS1743.

config CPM
	bool

endmenu
```
