## TVCam/ti-davinci/drivers/rapidio/Kconfig
```kconfig
#
# RapidIO configuration
#
config RAPIDIO_DISC_TIMEOUT
	int "Discovery timeout duration (seconds)"
	depends on RAPIDIO
	default "30"
	---help---
	  Amount of time a discovery node waits for a host to complete
	  enumeration beforing giving up.

config RAPIDIO_PROC_FS
	bool "I/O and Memory resource debug"
	depends on RAPIDIO && PROC_FS
	default y
	---help---
	  Enable this option, it will create a /proc/riores node for
	  monitoring the RapidIO I/O and Memory resource.

source "drivers/rapidio/sallocator/Kconfig"
```

## TVCam/ti-davinci/kernel/Kconfig.marker
```kconfig
# Code markers configuration

config MARKERS
	bool "Activate markers"
	select MODULES
	default n
	help
	  Place an empty function call at each marker site. Can be
	  dynamically changed for a probe function.

config MARKERS_DISABLE_OPTIMIZATION
	bool "Disable architecture specific marker optimization"
	depends EMBEDDED
	default n
	help
	  Disable code replacement jump optimisations. Especially useful if your
	  code is in a read-only rom/flash.
```

## TVCam/ti-davinci/kernel/time/Kconfig
```kconfig
#
# Timer subsystem related configuration options
#
config HIGH_RES_TIMERS
	bool "High Resolution Timer Support"
	depends on GENERIC_TIME && GENERIC_CLOCKEVENTS
	help
	  This option enables high resolution timer support. If your
	  hardware is not capable then this option only increases
	  the size of the kernel image.

config NO_HZ
	bool "Tickless System (Dynamic Ticks)"
	depends on HIGH_RES_TIMERS
	help
	  This option enables a tickless system: timer interrupts will
	  only trigger on an as-needed basis both when the system is
	  busy and when the system is idle.
```

## TVCam/ti-davinci/lib/Kconfig.kgdb
```kconfig
config WANT_EXTRA_DEBUG_INFORMATION
	bool
	select DEBUG_INFO
	select UNWIND_INFO if !ARM
	select FRAME_POINTER if X86 || SUPERH
	select STACK_UNWIND if X86
	default n

config KGDB
	bool "KGDB: kernel debugging with remote gdb"
	select WANT_EXTRA_DEBUG_INFORMATION
	select KGDB_ARCH_HAS_SHADOW_INFO if X86_64
	depends on DEBUG_KERNEL && !DEBUG_PREEMPT && (ARM || X86 || MIPS || (SUPERH && !SUPERH64) || IA64 || PPC)
	help
	  If you say Y here, it will be possible to remotely debug the
	  kernel using gdb.  Documentation of kernel debugger is available
	  at http://kgdb.sourceforge.net as well as in DocBook form
	  in Documentation/DocBook/.  If unsure, say N.

config KGDB_ARCH_HAS_SHADOW_INFO
	bool

config KGDB_CONSOLE
	bool "KGDB: Console messages through gdb"
	depends on KGDB
	  help
	    If you say Y here, console messages will appear through gdb.
	    Other consoles such as tty or ttyS will continue to work as usual.
	    Note, that if you use this in conjunction with KGDB_ETH, if the
	    ethernet driver runs into an error condition during use with KGDB
	    it is possible to hit an infinite recusrion, causing the kernel
	    to crash, and typically reboot.  For this reason, it is preferable
	    to use NETCONSOLE in conjunction with KGDB_ETH instead of
	    KGDB_CONSOLE.

choice
	prompt "Method for KGDB communication"
	depends on KGDB
	default KGDB_8250_NOMODULE
	default KGDB_MPSC if SERIAL_MPSC
	default KGDB_CPM_UART if (8xx || 8260)
	default KGDB_SIBYTE if (SIBYTE_SB1xxx_SOC || SIBYTE_BCM1x80)
 	default KGDB_TXX9 if CPU_TX49XX
	default KGDB_SH_SCI if SERIAL_SH_SCI
	default KGDB_PXA_SERIAL if ARCH_PXA
	default KGDB_AMBA_PL011 if ARM_AMBA
	help
	  There are a number of different ways in which you can communicate
	  with KGDB.  The most common is via serial, with the 8250 driver
	  (should your hardware have an 8250, or ns1655x style uart).
	  Another option is to use the NETPOLL framework and UDP, should
	  your ethernet card support this.  Other options may exist.
	  You can elect to have one core I/O driver that is built into the
	  kernel for debugging as the kernel is booting, or using only
	  kernel modules.

config KGDB_ONLY_MODULES
	bool "KGDB: Use only kernel modules for I/O"
	depends on MODULES
	help
	  Use only kernel modules to configure KGDB I/O after the
	  kernel is booted.

config KGDB_8250_NOMODULE
	bool "KGDB: On generic serial port (8250)"
	select KGDB_8250
	help
	  Uses generic serial port (8250) to communicate with the host
	  GDB.  This is independent of the normal (SERIAL_8250) driver
	  for this chipset.

config KGDBOE_NOMODULE
	bool "KGDB: On ethernet - in kernel"
	select KGDBOE
	help
	  Uses the NETPOLL API to communicate with the host GDB via UDP.
	  In order for this to work, the ethernet interface specified must
	  support the NETPOLL API, and this must be initialized at boot.
	  See the documentation for syntax.

config KGDB_MPSC
	bool "KGDB on MV64x60 MPSC"
	depends on SERIAL_MPSC
	help
	  Uses a Marvell GT64260B or MV64x60 Multi-Purpose Serial
	  Controller (MPSC) channel. Note that the GT64260A is not
	  supported.

config KGDB_CPM_UART
 	bool "KGDB: On CPM UART"
	depends on PPC && (CPM2 || 8xx)
 	help
 	  Uses CPM UART to communicate with the host GDB.

config KGDB_SIBYTE
	bool "KGDB: On the Broadcom SWARM serial port"
	depends on MIPS && (SIBYTE_SB1xxx_SOC || SIBYTE_BCM1x80)

config KGDB_TXX9
	bool "KGDB: On the TX4927/TX4937/TX4938 serial port"
	depends on MIPS && CPU_TX49XX
	help
	  Uses TX4927/TX4937/TX4938 serial port to communicate with
	  the host KGDB

config KGDB_SH_SCI
	bool "KGDB: On SH SCI(F) serial port"
	depends on SUPERH && SERIAL_SH_SCI
	help
	  Uses the SH SCI(F) serial port to communicate with the host GDB.

config KGDB_AMBA_PL011
	bool "KGDB: On ARM AMBA PL011 Serial Port"
	depends on ARM && (ARCH_VERSATILE || ARCH_REALVIEW)
	help
	  Enables the KGDB serial driver for the AMBA bus PL011 serial
          devices from ARM.

config KGDB_PXA_SERIAL
	bool "KGDB: On the PXA2xx serial port"
	depends on ARCH_PXA
	help
	  Enables the KGDB serial driver for Intel PXA SOC
endchoice

choice
 	prompt "SCC/SMC for KGDB console"
 	depends on KGDB_CPM_UART
 	default KGDB_CPM_UART_SCC4 if ADS8272
 	default KGDB_CPM_UART_SMC1 if MPC885ADS

config KGDB_CPM_UART_SCC1
 	bool "Use SCC1 for KGDB"
 	depends on SERIAL_CPM_SCC1

config KGDB_CPM_UART_SCC2
 	bool "Use SCC2 for KGDB"
 	depends on SERIAL_CPM_SCC2

config KGDB_CPM_UART_SCC3
 	bool "Use SCC3 for KGDB"
 	depends on SERIAL_CPM_SCC3

config KGDB_CPM_UART_SCC4
 	bool "Use SCC4 for KGDB"
 	depends on SERIAL_CPM_SCC4

config KGDB_CPM_UART_SMC1
 	bool "Use SMC1 for KGDB"
 	depends on SERIAL_CPM_SMC1

config KGDB_CPM_UART_SMC2
 	bool "Use SMC2 for KGDB"
 	depends on SERIAL_CPM_SMC2
endchoice

choice
	prompt "PXA serial UART for KGDB"
	depends on KGDB_PXA_SERIAL
	default KGDB_PXA_FFUART

config KGDB_PXA_FFUART
	bool "FFUART"

config KGDB_PXA_BTUART
	bool "BTUART"

config KGDB_PXA_STUART
	bool "STUART"
endchoice

config KGDBOE
	tristate "KGDB: On ethernet" if !KGDBOE_NOMODULE
	depends on m && KGDB
	select NETPOLL
	select NETPOLL_TRAP
	help
	  Uses the NETPOLL API to communicate with the host GDB via UDP.
	  In order for this to work, the ethernet interface specified must
	  support the NETPOLL API, and this must be initialized at boot.
	  See the documentation for syntax.

config KGDB_8250
	tristate "KGDB: On generic serial port (8250)" if !KGDB_8250_NOMODULE
	depends on m && KGDB_ONLY_MODULES
	help
	  Uses generic serial port (8250) to communicate with the host
	  GDB.  This is independent of the normal (SERIAL_8250) driver
	  for this chipset.

config KGDB_SIMPLE_SERIAL
	bool "Simple selection of KGDB serial port"
	depends on KGDB_8250_NOMODULE
	default y
	help
	  If you say Y here, you will only have to pick the baud rate
	  and port number that you wish to use for KGDB.  Note that this
	  only works on architectures that register known serial ports
	  early on.  If you say N, you will have to provide, either here
	  or on the command line, the type (I/O or MMIO), IRQ and
	  address to use.  If in doubt, say Y.

config KGDB_BAUDRATE
	int "Debug serial port baud rate"
	depends on (KGDB_8250 && KGDB_SIMPLE_SERIAL) ||	KGDB_PXA_SERIAL || KGDB_AMBA_PL011 || KGDB_CPM_UART
	default "115200"
	help
	  gdb and the kernel stub need to agree on the baud rate to be
	  used.  Standard rates from 9600 to 115200 are allowed, and this
	  may be overridden via the commandline.

config KGDB_PORT_NUM
	int "Serial port number for KGDB"
	range 0 1 if KGDB_MPSC
	range 0 3
	depends on (KGDB_8250 && KGDB_SIMPLE_SERIAL) || KGDB_MPSC
	default "1"
	help
	  Pick the port number (0 based) for KGDB to use.

config KGDB_AMBA_BASE
	hex "AMBA PL011 Serial Port Base Address"
	default 0x101f2000 if ARCH_VERSATILE
	depends on KGDB_AMBA_PL011
	help
	  Base address of the AMBA port that KGDB will use.

config KGDB_AMBA_UARTCLK
	int "AMBAPL011 Serial UART Clock Frequency"
	default 24000000 if ARCH_VERSATILE
	depends on KGDB_AMBA_PL011
	help
	  Frequency (in HZ) of the ARM AMBA UART clock

config KGDB_AMBA_IRQ
	int "AMBA PL011 Serial Port IRQ"
	default 13 if ARCH_VERSATILE
	depends on KGDB_AMBA_PL011
	help
	  Pick the IRQ of the AMBA port that KGDB will use.

config KGDB_8250_CONF_STRING
	string "Configuration string for KGDB"
	depends on KGDB_8250_NOMODULE && !KGDB_SIMPLE_SERIAL
	default "io,2f8,115200,3" if X86
	help
	  The format of this string should be <io or
	  mmio>,<address>,<baud rate>,<irq>.  For example, to use the
	  serial port on an i386 box located at 0x2f8 and 115200 baud
	  on IRQ 3 at use:
	  io,2f8,115200,3
```

## TVCam/ti-davinci/net/ipv6/Kconfig
```kconfig
#
# IPv6 configuration
#

#   IPv6 as module will cause a CRASH if you try to unload it
config IPV6
	tristate "The IPv6 protocol"
	default m
	---help---
	  This is complemental support for the IP version 6.
	  You will still be able to do traditional IPv4 networking as well.

	  For general information about IPv6, see
	  <http://playground.sun.com/pub/ipng/html/ipng-main.html>.
	  For Linux IPv6 development information, see <http://www.linux-ipv6.org>.
	  For specific information about IPv6 under Linux, read the HOWTO at
	  <http://www.bieringer.de/linux/IPv6/>.

	  To compile this protocol support as a module, choose M here: the 
	  module will be called ipv6.

config IPV6_PRIVACY
	bool "IPv6: Privacy Extensions support"
	depends on IPV6
	---help---
	  Privacy Extensions for Stateless Address Autoconfiguration in IPv6
	  support.  With this option, additional periodically-alter 
	  pseudo-random global-scope unicast address(es) will assigned to
	  your interface(s).
	
	  We use our standard pseudo random algorithm to generate randomized
	  interface identifier, instead of one described in RFC 3041.

	  By default, kernel do not generate temporary addresses.
	  To use temporary addresses, do
	
	        echo 2 >/proc/sys/net/ipv6/conf/all/use_tempaddr 

	  See <file:Documentation/networking/ip-sysctl.txt> for details.

config IPV6_ROUTER_PREF
	bool "IPv6: Router Preference (RFC 4191) support"
	depends on IPV6
	---help---
	  Router Preference is an optional extension to the Router
	  Advertisement message to improve the ability of hosts
	  to pick more appropriate router, especially when the hosts
	  is placed in a multi-homed network.

	  If unsure, say N.

config IPV6_ROUTE_INFO
	bool "IPv6: Route Information (RFC 4191) support (EXPERIMENTAL)"
	depends on IPV6_ROUTER_PREF && EXPERIMENTAL
	---help---
	  This is experimental support of Route Information.

	  If unsure, say N.

config INET6_AH
	tristate "IPv6: AH transformation"
	depends on IPV6
	select XFRM
	select CRYPTO
	select CRYPTO_HMAC
	select CRYPTO_MD5
	select CRYPTO_SHA1
	---help---
	  Support for IPsec AH.

	  If unsure, say Y.

config INET6_ESP
	tristate "IPv6: ESP transformation"
	depends on IPV6
	select XFRM
	select CRYPTO
	select CRYPTO_HMAC
	select CRYPTO_MD5
	select CRYPTO_SHA1
	select CRYPTO_DES
	---help---
	  Support for IPsec ESP.

	  If unsure, say Y.

config INET6_IPCOMP
	tristate "IPv6: IPComp transformation"
	depends on IPV6
	select XFRM
	select INET6_XFRM_TUNNEL
	select CRYPTO
	select CRYPTO_DEFLATE
	---help---
	  Support for IP Payload Compression Protocol (IPComp) (RFC3173),
	  typically needed for IPsec.

	  If unsure, say Y.

config INET6_XFRM_TUNNEL
	tristate
	select INET6_TUNNEL
	default n

config INET6_TUNNEL
	tristate
	default n

config INET6_XFRM_MODE_TRANSPORT
	tristate "IPv6: IPsec transport mode"
	depends on IPV6
	default IPV6
	select XFRM
	---help---
	  Support for IPsec transport mode.

	  If unsure, say Y.

config INET6_XFRM_MODE_TUNNEL
	tristate "IPv6: IPsec tunnel mode"
	depends on IPV6
	default IPV6
	select XFRM
	select IPV6_TUNNEL
	---help---
	  Support for IPsec tunnel mode.

	  If unsure, say Y.

config IPV6_TUNNEL
	tristate "IPv6: IPv6-in-IPv6 tunnel"
	select INET6_TUNNEL
	depends on IPV6
	---help---
	  Support for IPv6-in-IPv6 tunnels described in RFC 2473.

	  If unsure, say N.

config IPV6_MROUTE
	bool "IPv6: multicast routing (EXPERIMENTAL)"
	depends on IPV6 && EXPERIMENTAL
	---help---
	  Experimental support for IPv6 multicast forwarding.
	  If unsure, say N.

config IPV6_PIMSM_V2
	bool "IPv6: PIM-SM version 2 support (EXPERIMENTAL)"
	depends on IPV6_MROUTE
	---help---
	  Support for IPv6 PIM multicast routing protocol PIM-SMv2.
	  If unsure, say N.

config IPV6_STATISTICS
	bool "IPv6: per-interface statistics for SNMP"
	depends on IPV6 && EXPERIMENTAL

config IPV6_STATISTICS_DEBUG
	bool "IPv6: debug per-interface statistics for SNMP"
	depends on IPV6_STATISTICS
	---help---
	  Say N.

config IPV6_ADVANCED_ROUTER
	bool "IPv6: advanced router (EXPERIMENTAL)"
	depends on IPV6 && EXPERIMENTAL
	---help---
	  If you intend to run your Linux box mostly as an IPv6 router
	  or otherwise need more advanced routing features, say Y; you
	  will then be presented with several options that allow more
	  precise control about the routing process.

	  The answer to this question won't directly affect the kernel:
	  answering N will just cause the configurator to skip all the
	  questions about advanced routing.

	  If unsure, say N.

config IPV6_MULTIPLE_TABLES
	bool "IPv6: Multiple Routing Tables"
	depends on IPV6 && EXPERIMENTAL
	select FIB_RULES
	---help---
	  Normally, a router decides what to do with a received packet based
	  solely on the packet's final destination address.  If you say Y here,
	  the Linux router will also be able to take the packet's source
	  address and incoming interface into account.

	  If unsure, say N.

config IPV6_SUBTREES
	bool "IPv6: Source Address based Routing"
	depends on IPV6 && EXPERIMENTAL
	---help---
	  Enable policy routing by source address or prefix.  To set up source
	  address based routing you need to define source prefix specific
	  policy rules using iproute2 or a similar tool.

	  As the first matching policy rule is always applied, policy rules
	  should be ordered by decreasing source and destination prefix length,
	  with the exception of the preconfigured special local rule.

	  The destination address is still the primary routing key, so mixing
	  normal and source prefix specific routes in the same routing table
	  may sometimes lead to unintended routing behavior.  This can be
	  avoided by defining different routing tables for the normal and
	  source prefix specific routes.

	  If unsure, say N.

config IPV6_MIP6
	bool "IPv6: Mobility (EXPERIMENTAL)"
	depends on IPV6 && EXPERIMENTAL
	select XFRM
	select XFRM_USER
	select XFRM_ENHANCEMENT
	---help---
	  Support for IPv6 Mobility.

	  If unsure, say N.

config IPV6_MIP6_DEBUG
	bool "IPv6: Moblity Debug Message"
	depends on IPV6_MIP6
	---help---
	  Be sure to say Y and record debug messages when submitting a
	  bug report.
	  If unsure, say N.
```
