## revue/TVCam/ti-davinci/arch/arm/mach-da8xx/Kconfig
```kconfig
if ARCH_DA8XX

config	TI_CPPI41
	tristate "TI CPPI 4.1 support"
	help
	  Configure this option to include the CPPI 4.1 support.

choice
	prompt "DA830/OMAP-L137 Board Type"
	default MACH_DA8XX_EVM

config MACH_DA8XX_EVM
	bool "TI DA830/OMAP-L137 EVM"
	help
	  Configure this option to specify the whether the board used
	  for development is a DA830/OMAP-L137 EVM.

endchoice

config DA8XX_UI
	bool "DA830/OMAP-L137 UI (User Interface) board support"
	depends on MACH_DA8XX_EVM
	select DAVINCI_I2C_EXPANDER
	help
	  Support for the periferials located on User Interface board.

choice
	prompt "Select DA830/OMAP-L137 UI board peripheral"
	depends on DA8XX_UI

config DA8XX_UI_LCD
	bool "LCD"
	help
	  Configure this option to use LCD as a framebuffer or simple character
	  display.

config DA8XX_UI_NAND
	bool "NAND flash"
	help
	  Configure this option to specify the that CE3 will be used to
	  communicate to the NAND flash. Do not forget to setup the switch
	  correctly.

config DA8XX_UI_NOR
	bool "NOR flash"
	help
	  Configure this option to specify the that CE2/CE3 will be used to
	  communicate to the NOR flash. Do not forget to setup the switch
	  correctly.

endchoice

config SKIP_KICK_REGS_UNLOCK
	bool "Skip unlocking of CFG region using KICK registers"
	default n
	help
	  KICK registers on DA830/OMAP-L137 are provided to unlock access to CFG
	  register space on the SoC.

	  Unlocking KICK registers in Linux can lead to a race with similar
	  operation being attempted from the DSP side.

	  According to the KICK register documentation, there can be a race even
	  if both sides are only doing an unlock.  Net result will be that KICK
	  registers will remain locked and all the writes to CFG registers will
	  not take effect.

	  Ideally KICK registers should be unlocked once early in the boot
	  process and never locked back again. The only reason this code is in
	  Linux is to remain compatible with an older version of firmware which
	  does not unlock the KICK registers.

	  Say Y here if you care about DSP and ARM booting simultaneously.

	  This is being defaulted to N to ensure backward compatibility with
	  older firmware versions.

endif
```

## revue/TVCam/ti-davinci/arch/arm/mach-davinci/Kconfig
```kconfig
if ARCH_DAVINCI_TRUE

choice
	prompt "DaVinci Specific Core Type"
	default ARCH_DAVINCI644x

config ARCH_DAVINCI644x
	bool "DM644x"

config ARCH_DAVINCI_DM355
	bool "DM355"

config ARCH_DAVINCI_DM365
	bool "DaVinci DM365 based system"

config ARCH_DAVINCI_DM646x
        bool "DM646x"

config ARCH_DAVINCI_DM357
        bool "DM357"

endchoice

choice
	prompt "DaVinci Board Type"
        default MACH_DAVINCI_EVM

config MACH_DAVINCI_EVM
	bool "TI DaVinci EVM"
	depends on ARCH_DAVINCI644x
	help
	  Configure this option to specify the whether the board used
	  for development is a DaVinci EVM

config MACH_DAVINCI_DM355_EVM
	bool "TI DM355 EVM"
	depends on ARCH_DAVINCI_DM355
	help
	  Configure this option to specify the whether the board used
	  for development is a DM355 EVM

config MACH_DAVINCI_DM365_EVM
	bool "TI DM365 EVM"
	default n
	depends on ARCH_DAVINCI_DM365
	help
	  Configure this option to specify the whether the board used
	  for development is a DM365 EVM
	  
config MACH_DAVINCI_DM365_IPNC
	bool "TI DM365 IPNC"
	default n
	depends on ARCH_DAVINCI_DM365
	help
	  Configure this option to specify the whether the board used
	  for development is a DM365 IPNC	  

config MACH_DAVINCI_DM6467_EVM
        bool "TI DM646x EVM"
        depends on ARCH_DAVINCI_DM646x
        help
          Configure this option to specify the whether the board used
          for development is a DM646x EVM

config MACH_DAVINCI_DM357_EVM
	bool "TI DM357 EVM"
	depends on ARCH_DAVINCI_DM357
	help
	  Configure this option to specify the whether the board used
	  for development is a TI DM357 EVM

config MACH_DAVINCI_WOLVERINE
	bool "Logitech DM365 Wolverine"
	default n
	depends on ARCH_DAVINCI_DM365
	help
	  Configure this option to specify the whether the board used
	  for development is a Logitech DM365 Wolverine

endchoice

config DAVINCI_EVM_CF_SUPPORT
	bool "CF card support"
	depends on MACH_DAVINCI_EVM
	default y
	help
	  Configure this option to enable CompactFlash card support.

config DAVINCI_NAND_256KB_BLOCKS
        bool "NAND chip installed on DM355/DM365 EVMs has 256KB blocks"
        default y
        depends on MACH_DAVINCI_DM355_EVM || MACH_DAVINCI_DM365_EVM || MACH_DAVINCI_DM365_IPNC || MACH_DAVINCI_WOLVERINE
        help
        The boot firmware on the DM355/DM365 EVM assumes a default partition
        map for NAND flash based on erase block offsets. Thus, the partition
        map varies based on the size of the erase blocks in the particular NAND
        flash component installed on the board.  Answer Y here if the NAND
        chip (e.g a 16 Gigabit Micron MT29F16G08QAA) installed on your board
        has 256KB blocks.  Answer N here if the NAND chip (e.g. a 4 Gigabit
        Micron MT29F4G08AAA) installed on your board has 128KB blocks.

config DAVINCI_NAND_STD_LAYOUT
	bool "Support for standard NAND layout on DaVinci SOC's"
	default y
	depends on MACH_DAVINCI_DM355_EVM || MACH_DAVINCI_DM365_EVM || MACH_DAVINCI_DM365_IPNC || MACH_DAVINCI_WOLVERINE
	help
	  Support for the standard layout on DaVinci SOC's. Select this
	  option for enabling the new standard layout. Disabling this option
	  uses the legacy layout in DaVinci SOC's. Using Legacy layout is not
	  recommended.

config DM357_STORAGE_NAND
	bool "Use storage NAND"
	default y
	depends on MACH_DAVINCI_DM357_EVM
	help
	  Configure this option to choose the appropriate NAND in DM357
	  Choose y for 2 GB storage NAND or n for 64 MB boot NAND

config DAVINCI_KERNEL_SDRAM_OFFSET
	hex "SDRAM offset for the Kernel"
	default "0x0"
	help
	  Provide SDRAM offset, if you want to relocate Kernel image to a
	  different location (other than the DDR_BASE) in the SDRAM.
	  For e.g, if want to place DSP image in the beginning of the SDRAM,
	  provide DSP size as the SDRAM offset. Kernel image will then start
	  after the reserved SDRAM space for DSP. The default value is 0, which
	  means the Kernel will start at the DDR_BASE location.

config DAVINCI_KERNEL_ZRELADDR
	hex "ZRELADDR location for the Kernel"
	default "0x80008000"
	help
	  Provide ZRELADDR location for the kernel. The value should match with
	  default + SDRAM_OFFSET.

config DAVINCI_KERNEL_PARAMS_PHYS
	hex "PARAMS_PHYS location for the Kernel"
	default "0x80000100"
	help
	  Provide PARAMS_PHYS location for the kernel. The value should match
	  with default + SDRAM_OFFSET.

config DAVINCI_KERNEL_INITRD_PHYS
	hex "INITRD_PHYS location"
	default "0x80800000"
	help
	  Provide INITRD_PHYS location for the kernel. The value should match
	  with default + SDRAM_OFFSET.

endif
```

## revue/TVCam/ti-davinci/arch/arm/mach-mx2/Kconfig
```kconfig
menu "MX27 Options"
	depends on ARCH_MX2

config MACH_MX27ADS
	bool "Support MX27ADS platform"
	default y
	help
	  Include support for MX27ADS platform. This includes specific
	  configurations for the board and its peripherals.

config ARCH_MXC_HAS_NFC_V1
	bool "MXC NFC Hardware Version 1"
	default y
	help
	  This selects the Freescale MXC Nand Flash Controller Hardware Version 1
	  If unsure, say N.

endmenu
```

## revue/TVCam/ti-davinci/drivers/dma/Kconfig
```kconfig
#
# DMA engine configuration
#

menu "DMA Engine support"

config DMA_ENGINE
	bool "Support for DMA engines"
	---help---
	  DMA engines offload copy operations from the CPU to dedicated
	  hardware, allowing the copies to happen asynchronously.

comment "DMA Clients"

config NET_DMA
	bool "Network: TCP receive copy offload"
	depends on DMA_ENGINE && NET
	default y
	---help---
	  This enables the use of DMA engines in the network stack to
	  offload receive copy-to-user operations, freeing CPU cycles.
	  Since this is the main user of the DMA engine, it should be enabled;
	  say Y here.

config DMATEST
	tristate "DMA Test client"
	depends on DMA_ENGINE
	help
	  Simple DMA test client. Say N unless you're debugging a
	  DMA Device driver.

comment "DMA Devices"

config INTEL_IOATDMA
	tristate "Intel I/OAT DMA support"
	depends on DMA_ENGINE && PCI
	default m
	---help---
	  Enable support for the Intel(R) I/OAT DMA engine.

config FSL_DMA
	bool "Freescale MPC85xx/MPC83xx DMA support"
	depends on PPC
	select DMA_ENGINE
	---help---
	  Enable support for the Freescale DMA engine. Now, it support
	  MPC8560/40, MPC8555, MPC8548 and MPC8641 processors.
	  The MPC8349, MPC8360 is also supported.
endmenu
```

## revue/TVCam/ti-davinci/drivers/media/video/mxc/capture/Kconfig
```kconfig
if VIDEO_MXC_CAMERA

menu "MXC Camera/V4L2 PRP Features support"

config VIDEO_MXC_EMMA_CAMERA
	tristate "MX27 eMMA support"
	depends on VIDEO_MXC_CAMERA && MXC_EMMA && FB_MXC_SYNC_PANEL && (MXC_CAMERA_MICRON111 || MXC_CAMERA_MC521DA)
	select VIDEO_MXC_OPL
	default y

config VIDEO_MXC_CSI_DMA
	bool "CSI-DMA Still Image Capture support"
	depends on VIDEO_MXC_EMMA_CAMERA
	default n
	---help---
	  Use CSI-DMA method instead of CSI-PrP link to capture still image. This allows
	  to use less physical contiguous memory to capture big resolution still image. But
	  with this method the CSC (Color Space Conversion) and resize are not supported.
	  If unsure, say N.

choice
	depends on (VIDEO_MXC_CAMERA && I2C_MXC)
	prompt "Select Camera"
	default MXC_CAMERA_MICRON111

config MXC_CAMERA_MC521DA
	bool "Magnachip mc521da camera support"
	---help---
	  If you plan to use the mc521da Camera with your MXC system, say Y here.

config MXC_CAMERA_MICRON111
	bool "Micron mt9v111 camera support"
	---help---
	  If you plan to use the mt9v111 Camera with your MXC system, say Y here.
endchoice

endmenu

endif
```

## revue/TVCam/ti-davinci/drivers/mxc/Kconfig
```kconfig
# drivers/video/mxc/Kconfig

if ARCH_MXC

menu "MXC support drivers"

source "drivers/mxc/dam/Kconfig"
source "drivers/mxc/ssi/Kconfig"
source "drivers/mxc/pmic/Kconfig"
source "drivers/mxc/vpu/Kconfig"

endmenu

endif
```

## revue/TVCam/ti-davinci/drivers/mxc/pmic/mc13783/Kconfig
```kconfig
#
# PMIC Modules configuration
#

config MXC_MC13783_AUDIO
	tristate "MC13783 Audio support"
	depends on MXC_PMIC_MC13783
	help
	  This is the MC13783 audio module driver. This module provides kernel API
	  for audio part of MC13783.
	  If you want MC13783 audio support, you should say Y here
```

## revue/TVCam/ti-davinci/drivers/rapidio/sallocator/Kconfig
```kconfig
choice
	prompt "Default RapidIO Space Allocator"
	depends on RAPIDIO
	default RIO_SA_DEFAULT_BITMAP

	config RIO_SA_DEFAULT_BITMAP
		bool "Bitmap"

endchoice
```

## revue/TVCam/ti-davinci/drivers/vlynq/Kconfig
```kconfig
menu "VLYNQ support"

config DAVINCI_VLYNQ
	tristate "TI DaVinci VLYNQ Driver"
	default y
	depends on ARCH_DAVINCI644x || ARCH_DAVINCI_DM646x
	help
	  Configure this option to specify whether the Vlynq Driver is included
	  in the kernel.

endmenu
```
